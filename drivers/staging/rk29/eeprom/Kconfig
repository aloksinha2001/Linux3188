## drivers/staging/rk29/eeprom/Kconfig
```kconfig
menu "EEPROM AT24C16 FOR RK29"
config EEPROM_AT24C16
	tristate "ATMEL EEPROM AT24C16 CONTROL"
	default n
	help
      atmel eeprom at24c16 comntrol, with 2 wire control.
endmenu
```

## drivers/video/rockchip/Kconfig
```kconfig
menuconfig FB_ROCKCHIP
        tristate "Frame buffer support for Rockchip "
        depends on FB
        select FB_CFB_FILLRECT
        select FB_CFB_COPYAREA
        select FB_CFB_IMAGEBLIT
        ---help---
          Framebuffer driver for rockchip based platform

config EDID_BASICTOSVD_GEN2THOMAS_FIX
	bool     "EDID fix by gen2thomas to make all resolutions available"
  help
   This fix ensure that all resolutions from basic EDID block of your display 
   are also available for your device. In case the extended EDID block of your 
   display has some SVD's (short video descriptor) the basic EDID block 
   informations will be lost without this fix.
   
   Background: Some monitors EDID (f.e. acer P225HQL) have no duplicated entry in basic and
   extended block. F.e. the 1920x1080p resolution is only described in the basic EDID block 
   and some other resolutions are available as SVD of the extended EDID block.
   Therefore the 1920x1080p resolution (or possible others) will be lost although the monitor
   would support it.
   
config EDID_FINDBESTMODE_GEN2THOMAS_FIX
	bool     "EDID fix by gen2thomas to find best mode also for not sorted lists"
  help
   This patch get the best mode from the given list also in the case that the list is not sorted 
   correctly and also for the case that the highest resolution not match the given ratio of the
   screen. In that case the best resolution for the matching ratio to the screen is used. Also 
   for two equivalent resolutions the mode with the higher frequency is found and used. 
   
   Background: The original method only differentiate between two cases. But the real world know
   nine cases (three for x, three for y and the combinations). The patched algorithm know and match 
   all nine cases. 

config BASIC_EDID_DEBUG
	bool "EDID debug output of basic block"
	default n
	help
	  Say Y here if you want the EDID driver to output all sorts
	  of debugging information to provide to the maintainer when
	  something goes wrong.
	  
	  Set this to Y in case you need more informations about parsing the 
	  basic EDID block (first 128 bytes). Also some informations of the
	  not already completed implementation of (extended) E-EDID block 
	  could be displayed.

config HDMI_EDID_DEBUG
	bool "HDMI EDID debug output"
	default n
	help
	  Say Y here if you want the HDMI-EDID driver part to output all sorts
	  of debugging information to provide to the maintainer when
	  something goes wrong.
	  
	  Set this to Y in case you need more informations about the 
	  (extended) E-EDID block parsing. Also the binary content of the basic buffer
	  will be shown.
	  
config HDMI_LCDC_EDID_DEBUG
	bool "HDMI LCDC EDID debug output"
	default n
	help
	  Say Y here if you want the HDMI-LCDC-EDID driver part to output all sorts
	  of debugging information to provide to the maintainer when
	  something goes wrong.
	  
	  Set this to Y will cause more informations about the using of
	  parsed EDID for your device. "Show Sink Info" is part of this output. 

config FB_MIRRORING
	bool     "Mirroring support"
	depends on FB_ROCKCHIP
choice
        bool "Dual display ploy select"
	depends on FB_ROCKCHIP
	default NO_DUAL_DISP
        help
	  If you use dual lcdc for dual display ,select "implement dual display in kernel with dual lcdc"
	  If you use one lcdc like rk2928 or one lcdc with RK Jetta,select "one lcdc dual output display interface support"
	
config DUAL_LCDC_DUAL_DISP_IN_KERNEL
        bool "implement dual display in kernel with dual lcdc"
        depends on FB_ROCKCHIP
        help
          select y will implement dual screen display in kernel

config ONE_LCDC_DUAL_OUTPUT_INF
        bool "one lcdc dual output display interface support"
        depends on FB_ROCKCHIP
        help
          select y if on platform like rk2928 which have one lcdc but two output interface
config NO_DUAL_DISP
	bool "NO dual display needed"
	depends on FB_ROCKCHIP
	help
	  No dual display needed
endchoice

config FB_ROTATE
	bool"FB rotate support"
	depends on FB_ROCKCHIP
	default n
	help
	  select y if you need rotate your screen

config ROTATE_ORIENTATION
	int "rotate orientation"
	depends on FB_ROTATE
	default 0
	help
	  select 0, 90, 180,270 according to your Mold
config THREE_FB_BUFFER
        bool "Three fb buffer support"
        depends on FB_ROCKCHIP
        default y
        help
           select y if android support three buffer,like Jelly Bean


source "drivers/video/rockchip/lcdc/Kconfig"
source "drivers/video/rockchip/hdmi/Kconfig"
source "drivers/video/rockchip/rga/Kconfig"
source "drivers/video/rockchip/lvds/Kconfig"
source "drivers/video/rockchip/tvencoder/Kconfig"
```

## drivers/video/rockchip/hdmi/Kconfig
```kconfig
menuconfig RK_HDMI
       bool "Rockchip HDMI support"
       select FB_MODE_HELPERS
       
source "drivers/video/rockchip/hdmi/rk30/Kconfig"
source "drivers/video/rockchip/hdmi/rk2928/Kconfig"
source "drivers/video/rockchip/hdmi/sii902xa/Kconfig"
source "drivers/video/rockchip/hdmi/it66121/Kconfig"
source "drivers/video/rockchip/hdmi/softcec/Kconfig"

config RK_HDMI_DEBUG
		bool "Rockchip HDMI Debugging"
        depends on RK_HDMI
        default n
		help
		  Enableds verbose debugging the the HDMI drivers

config RK_HDMI_CTL_CODEC
		bool "Mute Codec When HDMI Actived"
		depends on RK_HDMI
		default n
		help
			If you say y heres, Codec will be mute when hdmi inserted,
			and unmute when removed. 
```

## drivers/video/rockchip/hdmi/it66121/Kconfig
```kconfig
config  IT66121
        bool "ITE HDMI transmitter IT66121 support"
        depends on RK_HDMI
        help
           Support ITE HDMI transmitter IT66121 if you say y here.
```

## drivers/video/rockchip/hdmi/rk2928/Kconfig
```kconfig
config  HDMI_RK2928
        bool "RK2928 HDMI support"
        depends on LCDC_RK2928 && RK_HDMI
        help
           Support rk2928 hdmi if you say y here

config HDCP_RK2928
	bool "RK2928 HDCP support"
        depends on HDMI_RK2928
        default n
	help
	  HDCP Interface. This adds the High Definition Content Protection Interface.
	  See http://www.digital-cp.com/ for HDCP specification.
```

## drivers/video/rockchip/hdmi/rk30/Kconfig
```kconfig
config  HDMI_RK30
        bool "RK30 HDMI support"
        depends on LCDC_RK30 && RK_HDMI
        help
           Support rk30 hdmi if you say y here
           
source "drivers/video/rockchip/hdmi/rk30/hdcp/Kconfig"
```

## drivers/video/rockchip/hdmi/sii902xa/Kconfig
```kconfig
config  SII902XA
        bool "Silicon Image HDMI transmitter SiI9022A/9024A support"
        depends on RK_HDMI
        help
           Support Silicon Image HDMI transmitter SiI9022A/9024A if you say y here.
```

## drivers/video/rockchip/hdmi/softcec/Kconfig
```kconfig
config  RK_HDMI_GPIO_CEC
        bool "Rockchip GPIO CEC"
        depends on RK_HDMI
        help
           Use gpio to simulate CEC
```

## drivers/video/rockchip/tvencoder/Kconfig
```kconfig
#
# TV Encoder drivers configuration
#

menuconfig RK_TVENCODER
	bool "Rockchip TV Encoder support"
    help
       Support RockChip TV Encoder if you say y here.

source "drivers/video/rockchip/tvencoder/rk610/Kconfig"
source "drivers/video/rockchip/tvencoder/rk1000/Kconfig"
source "drivers/video/rockchip/tvencoder/ch7025/Kconfig"
```

## drivers/video/rockchip/tvencoder/ch7025/Kconfig
```kconfig
#
# TV Encoder CH7025/7026 drivers configuration
#

config CH7025_7026_TVOUT
	bool "CH7025/7026 TV Encoder Support"
	depends on RK_TVENCODER
	help
		Support Chrontel CH7025/7026 TV Encoder.

config CH7025_7026_TVOUT_YPBPR
	bool "Support YPBPR Output"
	depends on CH7025_7026_TVOUT
			
config CH7025_7026_TVOUT_CVBS
	bool "Support CVBS Output"
	depends on CH7025_7026_TVOUT
```

## drivers/video/rockchip/tvencoder/rk610/Kconfig
```kconfig
#
# TV Encoder RK610 drivers configuration
#

config RK610_TVOUT
	bool "RK610(Jetta) TV Encoder support"
	depends on RK_TVENCODER
	select MFD_RK610
	help
		Support Jetta(RK610) to output YPbPr and CVBS.
		
config RK610_TVOUT_YPbPr
	bool "Support YPbPr Output"
	depends on RK610_TVOUT
config RK610_TVOUT_CVBS
	bool "Support CVBS Output"
	depends on RK610_TVOUT
```
